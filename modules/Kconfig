## modules/libspdm/Kconfig
```kconfig
config LIBSPDM
	bool "DMTF LibSPDM Support"
	help
	  Enable this option to install libspdm into firmware.
if LIBSPDM
config LIBSPDM_REQUESTER
	bool "Support SPDM requester"

config LIBSPDM_RESPONDER
	bool "Support SPDM responder"

config LIBSPDM_TRANSPORT_MCTP
	bool "Support MCTP transport"

config LIBSPDM_TRANSPORT_PCIDOE
	bool "Support PCIDOE transport"
endif
```

## west.yml
```yaml
# Copyright (c) 2021 Nordic Semiconductor ASA
# SPDX-License-Identifier: Apache-2.0

manifest:
  self:
    path: example-application

  remotes:
    - name: zephyrproject-rtos
      url-base: https://github.com/zephyrproject-rtos
    - name: leetroy
      url-base: https://github.com/leetroy

  projects:
    - name: zephyr
      remote: zephyrproject-rtos
      revision: main
      import: true
    - name: libspdm
      remote: leetroy
      path: modules/lib/libspdm
      revision: main
```
